VERSION ""

NS_ :

BS_:

BU_: can_sec_1 can_pri_1

BO_ 1 message_from_sec_to_pri: 8 can_sec_1
 SG_ signal_from_sec_to_pri : 1|8@1- (1,0) [0|0] ""  can_pri_1

BO_ 0 message_from_pri_to_sec: 8 can_pri_1
 SG_ signal_from_pri_to_sec : 8|8@1- (1,0) [0|0] ""  can_sec_1

BA_DEF_  "BusType" STRING ;
BA_DEF_DEF_  "BusType" "CAN";
