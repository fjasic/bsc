/*@!Encoding:1252*/
testcase thirdTestCase()
{
  long resWaitSig;
  
  resWaitSig = testWaitForSignalMatch(OnOff, 1, 5000);
  
  if (resWaitSig == 0)
  {
   testStepFail("1.3", "Timeout"); 
  }
  else 
  {
    testStepPass("1.3", "Signal Ok.");
    
  }
  
}


void MainTest()
{
  thirdTestCase();
  
}