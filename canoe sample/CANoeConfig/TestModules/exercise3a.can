/*@!Encoding:1250*/
testcase ctcLED()
{
  testCaseTitle("Test function","LED");
  
}

