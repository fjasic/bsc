/*@!Encoding:1252*/
testcase fifhtTestcase()
{
  char slovo;
  
  slovo = keyPressed();
  
  if (slovo == 'A')
  {
    testStepPass("1.5","Test je prosao");  
  }
  else if (slovo == 'a')
  {
    testStepFail("1.5","Test nije prosao");
  }
}

void MainTest()
{
  
  fifhtTestcase();
}