/*@!Encoding:1252*/
testcase fourthTestCase()
{
  
  long testerConf;
  
  testerConf = testWaitForTesterConfirmation("sandra", 15000);
  
  switch(testerConf){
    case 0:
      testStepWarning("Step 1", "No tester input");
      break;
    case 1:
      testStepPass("Step 1", "Output set correctly");
      break;
    case 2:
      testStepFail("Step 2", "Output set incorrectly");
      break;
    }
  
 }


void MainTest()
{
  fourthTestCase();
  
}