/*@!Encoding:1252*/
testcase secondTestCase()
{
  
  long tajmer;
  
  tajmer = testWaitForTimeout(1000);
  
  if (tajmer == 0)
  {
    testStepFail("1.2", "Test nije prosao.");
  }
  else
  {
    testStepPass("1.2", "Test prosao");
  }
  
}


void MainTest()
{
  secondTestCase();
  
}

